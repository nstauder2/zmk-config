## config/boards/shields/lily58/Kconfig.shield
```kconfig
config SHIELD_LILY58WIRELESS_LEFT
	def_bool $(shields_list_contains,lily58_left)

config SHIELD_LILY58WIRELESS_RIGHT
	def_bool $(shields_list_contains,lily58_right)
```
